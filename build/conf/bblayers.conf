## build/conf/bblayers.conf
```bitbake
# POKY_BBLAYERS_CONF_VERSION is increased each time build/conf/bblayers.conf
# changes incompatibly
POKY_BBLAYERS_CONF_VERSION = "2"

BBPATH = "${TOPDIR}"
BBFILES ?= ""

BBLAYERS ?= " \
  /opt/data/frieder/build/srcs/poky/meta \
  /opt/data/frieder/build/srcs/poky/meta-poky \
  /opt/data/frieder/build/srcs/poky/meta-yocto-bsp \
  "
```
